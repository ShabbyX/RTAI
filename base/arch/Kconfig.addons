## base/arch/x86_64/hal/Kconfig
```kconfig
mainmenu "RTAI/x86_64 configuration"

source "base/arch/Kconfig.hidden"

menu "General"

source "base/arch/Kconfig.general"

choice
	optional
	prompt "Private maintainer profiles"
	depends on RTAI_MAINTAINER

config RTAI_MAINTAINER_NONE
	bool "Use standard settings"

config RTAI_MAINTAINER_PMA
	bool "Use settings from mantegazza()aero!polimi!it"

endchoice
choice
	prompt "Inlining mode of user-space services"
	depends on RTAI_EXTENDED

config RTAI_LXRT_EXTERN_INLINE
	bool "Conditional inlining"
	help

	i.e. extern inline. Depends on compiler's optimization switch.

config RTAI_LXRT_STATIC_INLINE
	bool "Eager inlining"
	help

	i.e. static inline. Always inline regardless of compiler's
	optimization switch.

config RTAI_LXRT_NO_INLINE
	bool "No inlining"
	help

	Never inline user-space services. This implies linking
	client programs against the appropriate support library
	(e.g. liblxrt.a for LXRT services).

endchoice

endmenu

menu "Machine (x86)"

config RTAI_HAL_PREEMPT
	bool "Preemptible interrupt dispatching"
	depends on RTAI_EXTENDED
	default y

config RTAI_FPU_SUPPORT
	bool "Enable FPU support"
	default y
	help
	The FPU executes instructions from the processor's normal
	instruction stream. It can handle the types of high-precision
	floating-point processing operations commonly found in
	scientific, engineering, and business applications.  Enabling
	FPU support on a platform providing this hardware component
	may greatly improve performances.  

config RTAI_CPUS
	string "Number of CPUs (SMP-only)"
	default 2
	help
	RTAI has native support for Symmetrical Multi-Processing
	machines. If it is your case, you may want to enter here the
	number of CPUs of your motherboard.

	PAY ATTENTION: the default value is 2.

endmenu

menu "Base system"

config RTAI_SCHED_UP
	bool "Scheduler for uniprocessor machine (kernel tasks only)"
	depends on RTAI_SCHED_SMP=n && RTAI_SCHED_MUP=n
	default y

	help
	This option allows you to select the UP realtime scheduler to
	be interfaced to the RTAI module. This type of scheduler don't
	have to be used on a MP machine.

config RTAI_SCHED_SMP
	bool "Scheduler for SMP machine (kernel tasks only)"
	default n

	help
	This options corresponds to the Multi-Processing realtime
	scheduler. It can use either the 8254 or the local APIC
	timer. Be warned that the APIC based scheduler cannot be used
	for UP, unless you have the local APIC enabled, i.e. an SMP
	machine with just one CPU mounted on the motherboard.  It is a
	fully symmetric scheduler, where at task init all real time
	tasks default to using any available cpu.

config RTAI_SCHED_MUP
	bool "Multi-UP scheduler for SMP machine (kernel tasks only)"
	default n

	help
	Multi-Uniprocessor is a pseudo-SMP implementation where
	several virtual processors are going to be served by a single
	physical CPU. The system is therefore able to support several
	scheduling queues or pseudo-timers.

	RTAI offers an implementation of an MultiUniProcessor (MUP)
	realtime scheduler to be interfaced to the RTAI module. It is
	based on the local APIC timers. It can be profitably used on
	MP machines with just one CPU mounted on the motherboard.

	The advantage of using the MUP scheduler comes mainly from the
	possibility of using mixed timers simultaneously,
	i.e. periodic and oneshot, where periodic timers can be based
	on different periods, and of possibly forcing critical tasks
	on the CPU cache

	All the fuctions of UP and SMP schedulers are available in the
	MUP scheduler, as well as MUP specific functions can be used
	under UP-SMP.

config RTAI_SCHED_LXRT
	bool "LXRT scheduler (kernel and user-space tasks)"
	default y
	help

	LXRT is a user-space interface providing a symmetric API that
	may be used by both real-time RTAI tasks and linux
	processes. The full range of Linux system calls is then
	available and transitions between "soft" real-time and "hard"
	real-time can be performed.

	As far as scheduling is concerned, LXRT requires the use of
	SCHED_FIFO scheduling policy with statically assigned process
	priorities to achieve "soft" real-time performance whilst in
	user-space. Since LXRT provides the faculty to switch an
	application process to real-time, a real-time agent task is
	created and executes the real-time services on behalf of the
	LXRT process. 
	
	The NEWLXRT scheduler unifies U/MP and kernel/user space by
	scheduling Linux tasks/kernel threads natively, along with
	RTAI kernel tasks, all in one. In fact, NEWLXRT brings
	something new: a linux hard real-time application interface
	that is totally based on the scheduling of Linux tasks and
	kernel threads only. The NEWLXRT implementation doesn't need
	any RTAI proper task to be supported.

menu "Scheduler options"

	depends on RTAI_EXTENDED

source "base/arch/Kconfig.sched"

config RTAI_SCHED_8254_LATENCY
	string "8254 tuning latency (ns)"
	default 4700

config RTAI_SCHED_APIC_LATENCY
	string "APIC tuning latency (ns)"
	default 3944

endmenu

menu "IPC support"

source "base/arch/Kconfig.services"

config RTAI_NETRPC
	tristate "Net RPC"
	depends on RTAI_MSG
	default y if RTAI_MSG=y
	default m if RTAI_MSG=m
	help
	RPC means Remote Procedure Call. The NetRPC implementation
	corresponds to a synchronous intertask message passing which
	is the old concept and the basis of microkernels, either
	distributed or not.  Using NetRPC makes from RTAI a
	distributed system, both for kernel and user space
	applications.

	NetRPC depends on the messaging support.

	The NetRPC module will be called rtai_netrpc.o.

config RTAI_NETRPC_RTNET
	bool "Emulate RTNet"
	depends on RTAI_NETRPC
	default y

config RTAI_SHM
	tristate "Shared memory"
	default m
	help
	This RTAI specific module allows sharing memory inter-intra
	real-time tasks and Linux processes. In fact it can be an
	alternative to the SYSTEM V shared memory. It may also be
	noticed that the services are symmetrical, i.e. the same calls
	can be used both in real-time tasks (within the kernel) and
	Linux processes.
	The module will be called rtai_shm.o.

endmenu

menu "Other features"

source "base/arch/Kconfig.other"

config RTAI_MALLOC_HEAPSZ
	string "Size of the global heap (Kbytes)"
	depends on RTAI_MALLOC
	default 128
	help
	RTAI pre-allocates a global heap as part of its initialization
	chores. This parameter allows to define its size (in
	kilobytes).

config RTAI_TRACE
	bool "LTT support"
	default n
	help

	Originally, the Linux Trace Toolkit is a suite of tools
	designed to extract program execution details from the Linux
	operating system and interpret them. Specifically, it enables
	to extract processor utilization and allocation information
	for a certain period of time. It is then possible to perform
	various calculations on this data and dump this in a text
	file. This tool is enhanced by a GTK GUI which allows an easy
	exploitation of those results.  The Linux Trace Toolkit has
	been natively integrated into RTAI modules.
	You may refer to http://www.opersys.com/LTT/ for more information.

config RTAI_USI
	tristate "User-space interrupts"
	default m
	depends on RTAI_SEM && RTAI_TASKLETS
	default y if RTAI_SEM=y || RTAI_TASKLETS=y
	default m if RTAI_SEM=m || RTAI_TASKLETS=m
	help

	RTAI already contains some examples hinting at managing
	interrupts in user space, e.g: resumefromintr in lxrt-net_rpc,
	pressa in lxrt, but all of them require installing a proper
	handler in kernel space to wake up a hard real-time
	LXRT/NEWLXRT task.

	The user space interrupt support does the same but adds
	something that permits you to avoid writing anything in kernel
	space.

	The module will be called rtai_usi.o.
	
config RTAI_LEDS
	tristate "LEDS-based debugging support"
	default m
	help

	The module will be called rtai_leds.o.

endmenu

endmenu

menu "Add-ons"

source "base/arch/Kconfig.addons"

config RTAI_COMEDI_LXRT
	bool "Comedi support over LXRT"
	depends on RTAI_SCHED_LXRT
	default n
	help

	RTAI offers the kcomedilib interface to LXRT real-time
	applications. A kernel module will be built and a library will
	be provided. The kernel modules is called rtai_comedi.o and
	must be loaded if you want to use the libkcomedilxrt.a
	library.

config RTAI_COMEDI_DIR
	depends on RTAI_COMEDI_LXRT
	string "COMEDI installation directory"
	default "/usr/local"
	help

	You need the COMEDI support for data acquisition to build
	applications such as RTAILab.
	You can set the path to this package's installation
	directory here. More specifically, RTAI needs the file
	linux/comedilib.h.

config RTAI_SERIAL
	bool "Serial line driver"
	default y
	help

	RTAI provides a real-time serial driver.

	The module will be called rtai_serial.o.

endmenu

menu "RTAI Lab"

source "base/arch/Kconfig.lab"

endmenu
```
