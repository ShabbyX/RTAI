## base/arch/Kconfig.sched
```kconfig
#
# Scheduler configuration
#

config RTAI_SCHED_ISR_LOCK
	bool "Disable immediate rescheduling from within ISRs"
	default n
	help
	RTAI schedules as soon as a higher priority task is awaken in an
	interrupt handler, i.e. it does not wait to exit the handler itself.
	This is believed to be the best way, since a user that does not want
	it has just to care calling any scheduling API at the very end of
	her/his handler.
	Those wanting to have any awaken higher priority task scheduled only
	after exiting the ISR, regardless from where a scheduling API is
	called within the handler, should disable immediate rescheduling
	from ISRs by enabling this configuration option.

config RTAI_LONG_TIMED_LIST
	bool "Use a binary tree ordering for RTAI schedulers timed lists."
	default n
	help
	RTAI schedulers use a simple ordered linear list for suspended timed
	tasks by default. By enabling this option a binary sort type ordering
	is used. Such a scheme requires far less, albeit far more complex,
	operations to set up a time ordered list of wake up times. So when
	one has not so many tasks on the timed lists this option might not
	be worth having. The actual threshold value depends on many factors,
	CPU power being the main one. So it is up to you to make a choice.
	If you have many tens or even hundred(s) of timed tasks then it is
	likely that it might be worth enabling this option.

config RTAI_SCHED_LATENCY_SELFCALIBRATE
	bool "Latency self calibration"
	default y
	help
	Enable the self calibration of the scheduling latency when the RTAI
	scheduler is compiled with RTAI_SCHED_LATENCY set to 0.ù
	See also: RTAI_SCHED_LATENCY, RTAI_KERN_BUSY_ALIGN_RET_DELAY, 
	          RTAI_USER_BUSY_ALIGN_RET_DELAY.

config RTAI_SCHED_LATENCY
	string "Scheduling latency (ns)"
	default 0
        help
        The anticipation time to be used to program the hard timer mode for
	the next scheduling shot, in order to compensate for the programming
	overhead spent to set the right firing time.
	It could be determined with the calibration support provided by RTAI, 
	starting from a tentative configuration. 
	When it is set to zero and RTAI_SCHED_LATENCY_SELFCALIBRATE is enabled
	which are the default values available at the very first making, it 
	will trigger a self calibrating procedure when the RTAI scheduler is 
	made. 
	The same value is used for both kernel and user space tasks. Which
	means that, for an appropriate on time user space task, there could be 
	some anticipation for a kernel space task, i.e. a negative latency. 
	In such a case, the busy alignment options could be used to provide a 
	compromised on time scheduling for both spaces, albeit at a negligible 
	added cost for kernel tasks.
	When RTAI_SCHED_LATENCY_SELFCALIBRATE is enabled and RTAI_SCHED_LATENCY 
	is 0, the self calibration will:
	- evaluate the scheduler latency;
	- set an appropriate busy wait anticipation for kernel space; see 
	  the related config parameter;
	- set a negative appropriate busy wait anticipation for user space; 
	  the adoption of a negative value will impede any alignment, while
	  its absolute value will be an appropriate indication of what 
	  should be used if also a user space alignment is desired; see the 
	  related config parameter. It should nonetheless be remarked that,
	  because of the calibration being carried out in user space, there 
	  should be no alignement need there. 
	A user can then further tune such values at will, e.g. using the 
	calibration-helper. 

config RTAI_KERN_BUSY_ALIGN_RET_DELAY
	string "Delay to return to a switched in timed kernel task (ns)"
	default 0
	help
	The average time to return to the timed calling function after 
	switching back to a kernel space task. 
	It is subtracted from the resume time of a timed task to avoid 
	a delayed return when a busy wait to align to the resume time is 
	assigned by setting this parameter to a value > 0.
	A <= 0 value will skip the busy alignment. 
	Useful to allow the alignment application just for kernel tasks. 
	For example when a precise calibration for user space is used, a 
	kernel task will anticipate its timed resumption; so setting a 
	positive value here and a <= 0 busy wait time for the corresponding 
	user space option will allow applying the busy wait just to kernel 
	tasks.

config RTAI_USER_BUSY_ALIGN_RET_DELAY
	string "Delay to return to a switched in timed user task (ns)"
	default 0
	help
	The average time to return to the timed call function after switching 
	back to a user space task. 
	It is subtracted from the resume time of a timed task to avoid 
	a delayed return when a busy wait to align to the resume time is
	assigned by setting this parameter to a value > 0.
	A <= 0 value will skip the busy alignment.
	Usually it is not needed if the RTAI_SCHED_LATENCY has been calibrated
	in user space. 

config RTAI_SCHED_LXRT_NUMSLOTS
	string "Number of registrable RTAI objects"
	default 1024
	help
	The maximum number of registrable objects in RTAI.

config RTAI_MONITOR_EXECTIME
	bool "Track RTAI task execution time (per thousand)"
	default y
	help
	If this option is enabled, RTAI will keep track of time consumed by
	hard real time tasks.

	** Since this option uses the TSC it is better to avoid it in production
	for x86_32 CPUs not having TSCs, i.e. 486s and some untrue 586s. **

	This option also enables display of execution time of tasks, per thousand
	of the total time available, in the output of the RTAI scheduler proc file,
	e.g. "cat /proc/rtai/scheduler".

config RTAI_ALLOW_RR
	bool "Allow round-robin scheduling"
	default y
	help
	By enabling this option it is possible to use round robin scheduling
	in RTAI, after enabling such a mode on a task by task basis through a
	call to a suitable scheduler function.

config RTAI_FULL_PRINHER
	bool "Enable full priority inheritance"
	default n
	help
	In RTAI resource semaphores, aka mutexes, support two ways to
	manage priority inheritance, both for resource semaphores and
	intertask messages, blocked sent or rpced, to a task owning any
	resource semaphore already. Notice in fact that the task itself
	becomes a kind of "de facto" resource when any task blocks on it
	to exchange messages.
	Without enabling this option a task owning any resource will
	recover its base priority only when it releases the very last
	resource it owns. So full priority inheritance will work as
	it is usually expected for a singly owned resource only because,
	whenever a task achieves the ownership of more than one resource,
	priority inheritance will become an adaptive dynamic priority
	ceiling. In such a case in fact the task priority is increased
	according to the highest priority task waiting on any resource
	a task owns, itself included because of messages being exchanged
	with it, but it will be returned to its base priority only when all
	owned resources are released. This is a compromise design choice
	aimed at avoiding searches for the new priority to be inheredited
	across multiply owned resources and blocked tasks send/rpcing to
	the task.
	By enabling this configuration option instead you'll allow full
	priority inheritance, so that when a task releases any resource
	semaphore it owns it will acquire the priority of the most prioritary
	task, either waiting on any resource semaphore that it is still
	owned by the task or blocked send/rpcing to it.
	The choice is dependent on your needs mostly. Just take into account
	that the default dynamic priority ceiling is simpler, a bit more
	effective and less deadlock prone than full priority inheritance.

config RTAI_BUSY_TIME_ALIGN
	bool "Busy wait to ensure resume time alignment"
	default n
	help
	In oneshot mode there is a calibrated anticipation of the timer
	firing to compensate for the time overhead consumed in scheduling. 
	Sometimes, either because of a bad calibration or purposely, it is
	possible to anticipate the scheduling by setting a slightly larger than 
	needed anticipation. In such cases with this option one can be sure to
	achieve the desired scheduling time at the expense of waisting some
	processor time. Useful to achieve both more precise scheduled deadlines
	and non negative latency values.
	Do not set it if a hard periodic timer is to be used.
	Since a user space task has a higher scheduling latency, it can be
	usefully set to allow achieving better deadlines for kernel tasks, when
	the scheduling latency is calibrated for user space tasks.
	For more precise results see the following options.

config RTAI_ALIGN_LINUX_PRIORITY
	bool "Keep Linux task priority aligned to RTAI"
	default n
	help
	By enabling this option the RTAI scheduler will keep Linux tasks
	execution priority aligned to its. Naturally this makes sense
	either for Linux soft real time tasks enabled to use RTAI APIs,
	i.e. they issued rt_task_init/rt_task_init_schmod, or when RTAI
	hard real time tasks are given back to Linux.

config RTAI_ONE_SHOT
	bool "One-shot timer mode"
	default y
	help
	Set to enable one-shot timer mode as the default. If not set, the
	hard timer will run in periodic mode according to the period used
	in start_rt_timer().
	Notice that whatever the default setting chosen it is possible to
	override it by specifically calling either rt_set_oneshot_mode() or
	rt_set_periodic_mode() at run time.

config RTAI_CAL_FREQS_FACT
	string "Cure loosely calibrated frequencies - see help"
	default 0
	help
	This configuration parameter is meaningful for the oneshot mode only
	where it has two effects:
	1 - in oneshot mode using the APIC timer, i.e. always for SMP, a
	precise scheduling time depends also on the ratio cpu_freq/apic_freq.
	The best results can be achieved by using the RTAI calibration tool.
	If no calibration is run one will rely on what Linux makes available
	by default, which could be not precise enough, especially for not so
	short timed intervals.
	That leads to large and systematic latencies, especially in the case
	of low frequency schedules. By setting this option to a suitable
	value one can be sure that a certain firing frequency is granted
	even when relatively large idle periods are enconuntered, thus
	limiting the overall latency with which long sleeping tasks might
	be awaken in case of unprecise calibrations of the above cited
	frequencies;
	2 - in the case of very long timed list it will limit the search
	for the next firing time of widely scattered tasks with lowest
	priorities, thus avoiding useless scheduling delays. The granted
	firing interval will be roughly equal to:
	1.0/(RTAI_CAL_FREQS_FACT + 2.0) (seconds).
```
