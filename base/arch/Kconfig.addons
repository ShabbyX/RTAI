## base/arch/i386/Kconfig
```kconfig
mainmenu "RTAI/x86_32 configuration"

source "base/arch/Kconfig.hidden"

menu "General"

source "base/arch/Kconfig.general"

choice
	optional
	prompt "Private maintainer profiles"
	depends on RTAI_MAINTAINER

config RTAI_MAINTAINER_NONE
	bool "Use standard settings"

config RTAI_MAINTAINER_PMA
	bool "Use settings from mantegazza()aero!polimi!it"

endchoice

choice
	prompt "Inlining mode of user-space services"
#	depends on RTAI_EXTENDED
	help
	Allows choosing among:
	- Eager inlining:       i.e. static inline, always inline regardless 
	  of compiler's optimization switch;
	- Never inline:         i.e. user-space services are linked to 
	  programs against the appropriate support library (e.g. liblxrt.a 
	  for user space RTAI syscall services).
#	- Conditional inlining: i.e. extern inline, depends on compiler's 
#	  optimization switch;

config RTAI_LXRT_STATIC_INLINE
	bool "Eager inlining"
	help

#config RTAI_LXRT_EXTERN_INLINE
#	bool "Conditional inlining"
#	help

config RTAI_LXRT_NO_INLINE
	bool "No inlining"
	help

endchoice

endmenu

menu "Machine (x86_32)"

config RTAI_DONT_DISPATCH_CORE_IRQS
	bool "Direct vectoring of RTAI native interrupts"
#	depends on RTAI_EXTENDED
	default y
	help
	RTAI dispatches real time interrupts immediately to achieve as
	low a overhead as possible. Very important on low end CPUs. By
	setting this option it is possible to achieve a further improvement
	by allowing hard RTAI internal timers and SMP interprocessor 
	scheduling interrupts to be vectored directly to their handlers, 
	i.e without any dispatching overhead. A must on low end CPUs.

config RTAI_FPU_SUPPORT
	bool "Enable FPU support"
	default y
	help
	The FPU executes instructions from the processor's normal
	instruction stream. It can handle the types of high-precision
	floating-point processing operations commonly found in
	scientific, engineering, and business applications.  Enabling
	FPU support on a platform providing this hardware component
	may greatly improve performances.  You can obtain more
	information about Float-Point Unit on i386 platform on
	internet at the following URL:
	http://www.intel.com/design/intarch/techinfo/Pentium/fpu.htm

config RTAI_CPUS
	string "Number of CPUs (SMP-only)"
	default 2
	help
	RTAI has native support for Symmetrical Multi-Processing
	machines. If it is your case, you may want to enter here the
	number of CPUs of your motherboard.

	PAY ATTENTION: the default value is 2.

config RTAI_DIAG_TSC_SYNC
	bool "Diagnose out of sync MP-TSCs"
	default n
	help
	Check alignement of MP-TSCs, against a master CPU, and show them in
	the RTAI HAL proc file system (in TSC count units).

config RTAI_MASTER_TSC_CPU
	depends on RTAI_DIAG_TSC_SYNC
	string "Define the master CPU for aligning MP-TSCs"
	default 0
	help
	Master CPU for diagnosis and correction of TSCs alignement.

config RTAI_TUNE_TSC_SYNC
	depends on RTAI_DIAG_TSC_SYNC
	bool "Tune out of sync MP-TSCs"
	default n
	help
	Use offsets made available by enabling the out of sync diagnosis to
	keep readings of TSCs times as aligned as possible.

endmenu

menu "Base system"

menu "Scheduling options"

source "base/arch/Kconfig.sched"

config RTAI_RTC_FREQ
	string "Set RTC clock tick frequency and use RTC as the only timer"
	default 0
	help
	1 - Are you happy of working in periodic mode?
	2 - If so, is it accepable to resolve your timing needs with a 
	    tick within a frequency that can be varied just in powers of
	    2, from 2 to 8192 Hz?
	If both your answers are YES than it might be worth setting your 
	tick frequency of choice here and let RTAI schedulers work with 
	it using the Real Time Clock (RTC). Be careful though as:
	- you must not have configured the RTC as available to Linux;
	- RTC will be the only available timer and its tick frequency 
	  can be modified only here, so you must reconfigure this param 
	  to change it, setting it to zero to return using the other 
	  RTAI timers.
	The main advantage of using the RTC, if constraints 1 and 2 can be
	accepted, is that you will not touch any of the hard timing sources
	used by Linux (8254 especially and APIC too). In fact if an APIC 
	timer is available (SMP and recent machines) it is possible to avoid
	the most important interference with Linux timing by not using the 
	8254. However such a possibilty is not available on low end CPUs 
	and embedded systems for which the only way to avoid interfering with
	the Linux timer might be this option. Thus in such cases, 1-2 above 
	being acceptable once more, setting this config param might be a
	good choice.

config RTAI_SCHED_8254_LATENCY
	string "8254 tuning latency (ns)"
	default 4700
	help
	The anticipation time to be used to program the hard timer, in oneshot
	mode, for the next scheduling shot in order to compensate for the 
	programming overhead needed to determine the right firing time.
	This parameter has no effect when the periodic mode is used.

config RTAI_LXRT_USE_LINUX_SYSCALL
	bool "Use Linux syscall mechanism for RTAI calls from user space"
	default y
	help
	With this option enabled, RTAI uses the Linux syscall mechanism
	for its service calls, including RTAI own srqs, as provided by libc 
	"syscall".  This may improve signal handling (and therefore debugging 
	of RTAI applications), but has the drawback of a slight overhead,
	which might be more than compensated on cpus having the SysEnter Present
	(SEP) flag, see "cat /proc/cpuinfo".

	When direct inlining of RTAI syscalls is enabled, see the related
	configuration options, it is still possible to force the use of 
	the Linux syscall mechanism, even if this configuration parameter 
	has not been set. Notice that RTAI own srqs are inlined always.
	So, since it all depends on the definition of the USE_LINUX_SYSCALL 
	macro, the only thing to do is to add:
	#define USE_LINUX_SYSCALL
	after all of the RTAI headers inclusion in any source file in which 
	you want to use the Linux syscall mechanism, to be sure that the macro
	USE_LINUX_SYSCALL will not be redifined afterward. In the same way 
	when this parameter is set you can selectively revert to RTAI own 
	syscall mechanism by defining:
	#undef USE_LINUX_SYSCALL
	after all of the RTAI headers inclusion in any source file in which 
	you want to use the LXRT syscall mechanism.
	RTAI will then operate in mixed mode selectively by using both 
	its own and Linux syscall mechanisms.
	
	If in doubt, say no.

endmenu

menu "Supported services"

source "base/arch/Kconfig.services"

config RTAI_SHM
	tristate "Shared memory"
	default m
	help
	This RTAI specific module allows sharing memory inter-intra
	real-time tasks and Linux processes. In fact it can be an
	alternative to the SYSTEM V shared memory. It may also be
	noticed that the services are symmetrical, i.e. the same calls
	can be used both in real-time tasks (within the kernel) and
	Linux processes.
	The module will be called rtai_shm.o.

endmenu

menu "Other features"

config RTAI_IMMEDIATE_LINUX_SYSCALL
	bool "Immediate Linux syscall in hard real time"
	default n
	help
	This parameter allows to control RTAI behaviour when a Linux syscall
	is made while in hard real time, according to the following two ways:
	- 1) 	- if it is set RTAI will put the task back into Linux hands,
		  i.e pass it to soft mode; 
		- call the related sys service immediately, i.e. without 
		  going through the Linux syscall path;
		- put the task back to hard real time, so that it will return
		  to user space in hard real time mode again.
	- 2) 	- if it is not set RTAI will put the task back into Linux hands,
		  i.e pass it to soft mode; 
		- call the related sys service through the Linux syscall path;
		- return to user space in soft real time mode;
		- resume hard real time at the next call of an RTAI function.
	The marginally most efficient behaviour is likely 1 but 2, the default,
	is safer.
	It is remarked that nothing is changed if hard/soft transitions 
	are called controlled by an application task through 
	rt_make_hard_real_time/rt_make_soft_real_time.

source "base/arch/Kconfig.other"

config RTAI_MALLOC_HEAPSZ
	string "Size of the global heap (Kbytes)"
	depends on RTAI_MALLOC
	default 2048
	help
	RTAI pre-allocates a global heap as part of its initialization
	chores. This parameter allows to define its size (in
	kilobytes).

config RTAI_TRACE
	bool "LTT support"
	default n
	help
	Originally, the Linux Trace Toolkit is a suite of tools
	designed to extract program execution details from the Linux
	operating system and interpret them. Specifically, it enables
	to extract processor utilization and allocation information
	for a certain period of time. It is then possible to perform
	various calculations on this data and dump this in a text
	file. This tool is enhanced by a GTK GUI which allows an easy
	exploitation of those results.  The Linux Trace Toolkit has
	been natively integrated into RTAI modules.
	You may refer to http://www.opersys.com/LTT/ for more information.

config RTAI_LEDS
	tristate "LEDS-based debugging support"
	default n
	help
	The module will be called rtai_leds.o.

endmenu

endmenu

menu "Add-ons"

source "base/arch/Kconfig.addons"

source "base/arch/Kconfig.rtdm"

menu "Drivers"

config RTAI_DRIVERS_SERIAL
	bool "RTAI serial line driver"
	default y
	help
	The RTAI real-time serial driver.
	The module will be called rtai_serial.o.

config RTAI_DRIVERS_16550A
	bool "RTDM based 16550A driver support"
	depends on RTAI_RTDM
	default n
	help
	An alternate RTAI real-time serial driver based on RTDM.
	The module will be called rtai_16550A.o.

choice
	prompt "Hardware access mode"
	depends on RTAI_DRIVERS_16550A
	default RTAI_16550A_PIO
	help
	Allows choosing among:

	- Port based:    driver uses I/O ports, as defined by module vector 
                         parameters "io=port1,port2,...".

	- Memory mapped: driver uses memory mapping, as defined by module
			 vector parameters "mem=addr1,addr2,...".

	- Whatever:      the driver can use both I/O and memory mapping, as
			 assigned by "io" and "mem" module vectors parameters,
			 but with only one mode allowed for each device e.g.:
			 "io=0x2F8,0,0x3F8 mem=0,0xe0000000,0"; for devices 1,
			 2 and 3 respectively.

config RTAI_16550A_PIO
	bool "Port based"

config RTAI_16550A_MMIO
	bool "Memory mapped"

config RTAI_16550A_ANY
	bool "Whatever port and memory mix"

endchoice

endmenu

endmenu

menu "RTAI Lab"

source "base/arch/Kconfig.lab"

endmenu
```
