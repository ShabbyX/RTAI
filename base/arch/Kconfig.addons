## base/arch/Kconfig.addons
```kconfig
#
# Addons to RTAI
#

config RTAI_COMEDI_LXRT
	bool "Real Time COMEDI support in user space"
	default n
	help
	RTAI offers a unified COMEDI interface to kernel/user space real-time
	applications. A kernel module will be built and a library will be
	provided. The kernel modules is called rtai_comedi.o and must be
	loaded if you want to use the libkcomedilxrt.a library.

config RTAI_COMEDI_DIR
	depends on RTAI_COMEDI_LXRT
	string "COMEDI installation directory"
	default "/usr/local"
	help
	Since COMEDI support for data acquisition to build your
	applications, such as for RTAILab, has been chosen, you 
	must set the path to your COMEDI installation directory 
	here. Notice that RTAI support for COMEDI is based on 
	the comedi.git repository found at "www.comedi.org". 
	RTAI requires also comedilib.h found in the comedilib.git 
	repository at the sime site.

config RTAI_USE_COMEDI_LOCK
	depends on RTAI_COMEDI_LXRT
	bool "Use COMEDI lock by default"
	default "n"
	help
	You may need the COMEDI lock for data acquisition when sharing a
	board among many users. You can lock/unlock explicitly any
	operation by calling comedi_lock/unlock yourself. By setting this
	parameter all functions needing a lock for a safe shared use are
	lock/unlocked by default. It can be useful to save a couple of
	calls to enforce locking from user space. Little is gained with it
	in kernel space.
```

## base/arch/Kconfig.doc
```kconfig
#
# Documentation
#

config RTAI_DOX_DOC
	bool "Build RTAI Doxygen documentation (HTML)"
	default n
	help
	This option causes the Doxygen-based RTAI documentation to be
	built. This option is intended for people actually writing
	documentation and who want to update the pre-built manuals,
	regular users can just use the latter directly. You will need
	the Doxygen toolsuite for regenerating the documentation.

config RTAI_DOC_LATEX_NONSTOP
	bool "Enable LaTeX verbose output"
	default n
	help
	By default, all documentation generated with LaTeX uses the
	silent (batchmode) of LaTeX. If this option is enabled, the
	verbose (nonstopmode) of LaTeX will be used instead. This
	option is mainly intended for people writing RTAI
	documentation.

config RTAI_DBX_DOC
	bool "Build DocBook XML documentation (HTML/PDF)"
	default n
	help
	This option causes the DocBook XML based RTAI documentation to be
	built. This option is intended for people actually writing
	documentation and who want to update the pre-built manuals,
	regular users can just use the latter directly.

config RTAI_DBX_NET
	bool "Let the DocBook XML tools use network"
	depends on RTAI_DBX_DOC
	default n
	help
	Let the DocBook tools use internet to fetch the DTD and XSL stylesheets.
	If disabled, the documentation generation will fail if the necessary
	DTD(s) and XSL stylesheets can not be found on the local computer.

config RTAI_DBX_ROOT
	string "Docbook XML root"
	depends on RTAI_DBX_DOC
	default ""
	help
	Specify the DocBook XML root (that is, the directory where docbook.dtd
	should be taken). Leave blank to let configure try the "well-known"
	locations.

config RTAI_DBX_XSL_ROOT
	string "Docbook XML XSL stylesheet root"
	depends on RTAI_DBX_DOC
	default ""
	help
	Specify the DocBook XML XSL root. Leave blank to let configure try the
	"well-known" locations.

config RTAI_GUIDE
	bool "Build RTAI guide"
	default n
	help
	This option causes the Pandoc-based RTAI guide to be built.
	The guide is not completed yet and its output format not decided.
	You will need the Pandoc toolsuite for regenerating the guide.
```

## base/arch/Kconfig.general
```kconfig
#
# General configuration
#

config RTAI_INSTALLDIR
	string "Installation directory"
	default "/usr/realtime"

	help
	This option defines the directory where the various RTAI
	files will be installed on your target system.

	This directory may be changed if you double-click in the area
	named "Value". The default installation directory is
	/usr/realtime.

config RTAI_LINUXDIR
	string "Linux source tree"
	default "/usr/src/linux"
	help
	This variable contains the directory of your previously
	patched Linux kernel. As explained before, you can changed the
	value of the Linux source tree which is fixed by default to
	/usr/src/linux.

menu "RTAI Documentation"

source "base/arch/Kconfig.doc"

endmenu

config RTAI_TESTSUITE
	bool "Build RTAI testsuite"
	default y
	help
	Once you are done with the building process of RTAI, it may be
	safe to run the testsuite to make sure your RTAI system is
	functional. However if it does not it is possible that RTAI is not
	the only one to blame, check your kernel config also.

config RTAI_COMPAT
	bool "Enable source compatibility mode"
	default y
	help
	This option allows to preserve the compatibility between
	applications issued from the 24.1.x version of RTAI and the
	3.x branch.  This way, no adaptation in the header files is
	required.

config RTAI_EXTENDED
	bool "Enable extended configuration mode"
	default n
	help
	Allows some configuration parameters in the Hardware
	Abstraction Layer or the schedulers.

config RTAI_KMOD_DEBUG
	bool "Enable debug symbols in modules"
	depends on RTAI_EXTENDED
	default n
	help
	This options adds the -g flag when compiling
	kernel modules.

config RTAI_USER_DEBUG
	bool "Enable debug symbols in user-space programs"
	depends on RTAI_EXTENDED
	default n
	help
	This options adds the -g flag when compiling user-space programs.
	User space RTAI syscall by simple inlining is implicitely disabled.

config RTAI_MAINTAINER
	bool "Enable maintainer mode"
	depends on RTAI_EXTENDED
	default n
	help
	This option will activate the '--enable-maintainer-mode'
	option in the configure scripts. For more information, refer
	to the autoconf documentation:
	http://sources.redhat.com/autobook/autobook/autobook_26.html#SEC26

config RTAI_MAINTAINER_AUTOTOOLS
	bool "Enable Autoconf/Automake maintainer mode"
	depends on RTAI_MAINTAINER
	default n

choice
	optional
	prompt "Private maintainer profiles"
	depends on RTAI_MAINTAINER

config RTAI_MAINTAINER_NONE
	bool "Use standard settings"

config RTAI_MAINTAINER_PMA
	bool "Use settings from mantegazza()aero!polimi!it"

endchoice

config RTAI_QUIET
	bool "Quiet build"
	default y
	help
	If enabled, building would be less verbose. If not, the complete
	build command is written for each command.

config RTAI_STARTUP_LOAD
	bool "Load RTAI modules on startup"
	default y
	help
	If enabled, a script would be installed in /etc/init.d and configured
	to run at startup and shutdown to load and unload RTAI modules
	automatically.

	If you are not sure about system stability upon loading RTAI modules,
	disable this option, or after installation do:

	    sudo update-rc.d rtai disable
```

## base/arch/Kconfig.hidden
```kconfig
#
# Hidden configuration
#

config MODULES
	bool
	default y

config RTAI_VERSION
	string
	default "5.0 (unofficial)"
```

## base/arch/Kconfig.lab
```kconfig
#
# RTAI Lab configuration
#

config RTAI_LAB
	bool "RTAI Lab"
	default n
	help

	RTAI-Lab is a tool that allows the execution of any suite of
	real-time controllers/simulators automatically generated by
	Matlab/Simulink/RTW, hereafter addressed as RTW, and/or
	Scilab/Scicos/CodeGen, addressed as SCICOS:
	- in a local/remote/distributed way,
	- by monitoring their local/remote/distributed execution,
	- by changing their parameters on the fly for performance supervision,
	  monitoring, tuning and optimisation.

config RTAI_EFLTK_DIR
	depends on RTAI_LAB
	string "EFLTK installation directory"
	default "/usr/local"
	help

	You need the Extended Fast Light Toolkit (EFLTK) to build
	RTAILab. You can set the path to this package's installation
	directory here.
```

## base/arch/Kconfig.other
```kconfig
#
# Other features
#

config RTAI_USE_NEWERR
	bool "New return values of blocking RTAI APIs"
	default n
	help
	Return values for RTAI blocking APIs are a bit sketchy. That
	is due to a long standing legacy dating back to DOS and 8 bits PCs,
	when saving a few "if"s might have been important. Whatever one's
	opinion such a legacy has now been likely inheredited by many well
	working existing RTAI applications, that might break with a new
	error return scheme. In any case a better set of error return values
	might be useful nowadays, so it has been added. With it one will be
	able to correctly infer more detailed reasons for error returns i.e.:
	- invalid requests (RTE_OBJINV),
	- async unblocking (RTE_UNBLKD),
	- timeouts (RTE_TIMOUT),
	- timer overruns (RTE_TMROVRN),
	- deletion of blocking objects (RTE_OBJREM).
	Thus the new scheme has been made configurable to allow RTAI users
	to choose what to do, without forcing any adaption for already
	existing working applications.

config RTAI_MATH
	tristate "Mathfuns support in kernel"
	depends on RTAI_FPU_SUPPORT
	default y
	help
	This parameter allows buiding a module containing math support
	functions for kernel space. It might be useful to avoid fighting
	for the use of libc within the kernel.

config RTAI_MATH_C99
	bool "C99 standard support"
	depends on RTAI_MATH
	default n

config RTAI_MALLOC
	tristate "Real-time malloc support"
	default y
	help
	RTAI provides a real-time implementation of malloc(). This allows
	real-time tasks to allocate and free memory safely while executing
	in the real-time domain. If it is not enabled kernel's kmalloc will
	be used. So disabling this option is acceptable if you'll care
	to do any allocation while in Linux context only, i.e. at modules
	initialisation.
	The module will be called rtai_malloc.o.

config RTAI_USE_TLSF
	bool "Allocate memory using TLSF in place of BSD one"
	depends on RTAI_MALLOC
	default n
	help
	RTAI dynamic memory allocation support offers two different methods
	to allocate memory chunks. The default one is along the lines
	illustrated in:
	"Design of a General Purpose Memory Allocator for the 4.3BSD Unix
	 Kernel" by Marshall K. McKusick.
	By enabling this option the:
	"Two Levels Segregated Lists (TLSF)" as found at:
	http://rtportal.upv.es/rtmalloc/allocators/tlsf/
	will be used instead.
	Rough measures seems to indicate small differences between the two
	in term of alloc/free times, likely with BSD being better for the
	tested allocation sizes (up to a few KBs), but TLSF seems to have
	better, i.e. lower, fragmentation properties. In any case you should
	check it yourself within your own applications.

config RTAI_MALLOC_VMALLOC
	bool "Use vmalloc() support"
	depends on RTAI_MALLOC
	default y
	help
	RTAI's malloc support offers two different ways to allocate memory
	chunks, i.e. kmalloc and vmalloc.
	The reasons for using vmalloc:
	- it is simpler to share allocated buffers with user space;
	- it doesn't have the size restrictions of kmalloc.
	The reasons for using kmalloc:
	- it is faster (not important since it as to be used in soft real time);
	- it exhibits contiguous buffer addressing needed for DMA controllers
	  which don't have scattering/gathering capability.
	The default is using kmalloc()

config RTAI_KSTACK_HEAPSZ
	string "Size of stacks heap for RTAI own kernel tasks (Kbytes)"
	depends on RTAI_MALLOC
	default 512
	help
	RTAI pre-allocates a heap for the stacks of its own kernel tasks.
	This parameter allows to define its size (in kilobytes).

config RTAI_TASK_SWITCH_SIGNAL
	bool "task switches specific signal"
	default n
	help
	RTAI can signal a task switch each time a task resumes execution.
	The way it is done depends on the execution space:
	- kernel: execute a function assigned at rt_task_init or by calling
	  rt_task_signal_handler;
	- user: install an RTAI own signal handler and have it called at any
	  task switch through its number, assigned by calling
	  rt_task_signal_handler.
	The default is to not make available this feature, so you must enable
	it explicitly if it is useful for your application.

config RTAI_USI
	bool "User-space interrupts"
	default n
	help
	RTAI examples are available to show managing interrupts in user
	space, e.g: resumefromintr in "showroom" CVS (kernel/user/netrpc),
	"pressa" in "showroom" (user); but all of them require installing
	a proper handler in kernel space, to wake up a hard real-time user
	space task.
	The user space interrupt support does much of the same, but adds
	something that permits you to write nothing in kernel space.
	The module will be called rtai_usi.o.

config RTAI_WD
	bool "Watchdog support"
	default n
	help
	The purpose of the watchdog is to provide protection services
	to RTAI thereby protecting it (and the host Linux OS) against
	programming errors in RTAI applications.
	The RTAI module and a scheduler should be mounted to use the
	watchdog and once mounted, it will constantly monitor periodic
	real-time tasks that already exist, or that are created later.
	However this feature is optional and it is assumed that your
	RTAI applications are well behaved so that RTAI should behave
	the same whether or not you have the watchdog mounted. The
	overhead imposed by the watchdog depends on the speed that you
	run it, but in most cases should be minimal.
	The following watchdog policies are possible:
	- do nothing other than log some messages and keep a record of
	  the bad task;
	- resynchronise the task's frame time and nothing more;
	- debug policy which is a special case of the above
	  resynchronisation policy;
	- stretch the period of the offending task until it no longer
	  overruns;
	- slip the offending task by forcibly suspending it for a
	  percentage of its period;
	- suspend the offending task so that it no longer threaten the system;
	- kill the offending task and remove all traces.
	The module will be called rtai_wd.o.

config RTAI_HARD_SOFT_TOGGLER
	bool "Install Linux signal handler to toggle hard-soft modes"
	default n
	help
	By setting this option RTAI will install a Linux signal (SIGUSR1) and 
	handler, when any of the available task-thread init functions is called
	to enable the usage of its own APIs. With it is possible to toggle the 
	hard-soft mode of any task, asynchronously and outside of it, by using 
	some form of KILL, i.e.: "kill -USR1 <pid>" from a shell, or 
	"kill(pid, SIGUSR1)" from a C function. For the latter case the helper 
	function "pid_t rt_get_linux_tid(RT_TASK *rt_task)" has been added to
	help in quickly getting the pid of the RTAI task extension "rt_task" 
	of a Linux task.
```

## base/arch/Kconfig.rtdm
```kconfig
#
# RTDM configurations
#

config RTAI_RTDM
	bool "Real-Time Driver Model over RTAI"
	default n
	help
	Real Time Drive Model specific implementation for RTAI.

config RTAI_RTDM_FD_MAX
	depends on RTAI_RTDM
	string "Number of RTDM file descriptors"
	default 128
	help
	The maximum number of file descriptors in RTDM.

config RTAI_RTDM_SELECT
	depends on RTAI_RTDM
	bool "Enable select multiplexing for RTDM services"
	default n
	help
	By enabling this option, select(2) support can be used to monitor
	access to multiple RTDM services all in one, as for the standard UNIX
	support, with the exception of the timeout argument format. Being it
	RTDM specific nanoseconds are used directly in place of
	timeval/timespec.

config RTAI_RTDM_SHIRQ
	depends on RTAI_RTDM
	bool "Shared interrupts"
	default n
	help
	Make it possible for RTDM own interrupt handlers to manage shared
	interrupts.

config RTAI_DEBUG_RTDM
	depends on RTAI_RTDM
	bool "Enable some elementary RTDM debugging messages"
	default n
	help
	Enable some elementary debugging of wrong requests to RTDM, in the
	form of messages asserting what's improper and where it's happening.
```
